## config/west.yml
```yaml
manifest:
  remotes:
    - name: refil
      url-base: https://github.com/refil
    - name: Greg-T8
      url-base: https://github.com/Greg-T8
  projects:
    - name: zmk
      remote: refil
      revision: adv360-z3.5-2
      import: app/west.yml
  self:
    path: config
```
